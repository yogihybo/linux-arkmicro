## u-boot/board/arkmicro/arkn141-shoulang/Kconfig
```kconfig
if TARGET_ARKN141_SHOULANG

config SYS_BOARD
	default "arkn141-shoulang"

config SYS_VENDOR
	default "arkmicro"

config SYS_CONFIG_NAME
	default "arkn141-shoulang"

endif
```

## u-boot/board/arkmicro/arkn141-sqwf/Kconfig
```kconfig
if TARGET_ARKN141_SQWF

config SYS_BOARD
	default "arkn141-sqwf"

config SYS_VENDOR
	default "arkmicro"

config SYS_CONFIG_NAME
	default "arkn141-sqwf"

endif
```

## u-boot/board/arkmicro/arkn141/Kconfig
```kconfig
if TARGET_ARKN141

config SYS_BOARD
	default "arkn141"

config SYS_VENDOR
	default "arkmicro"

config SYS_CONFIG_NAME
	default "arkn141"

endif
```

## u-boot/board/arkmicro/arkn141_dongle_sim/Kconfig
```kconfig
if TARGET_ARKN141_DONGLE_SIM

config SYS_BOARD
	default "arkn141_dongle_sim"

config SYS_VENDOR
	default "arkmicro"

config SYS_CONFIG_NAME
	default "arkn141_dongle_sim"

endif
```

## u-boot/board/arkmicro/arkn141_dongle_xinshiyu/Kconfig
```kconfig
if TARGET_ARKN141_DONGLE_XINSHIYU

config SYS_BOARD
	default "arkn141_dongle_xinshiyu"

config SYS_VENDOR
	default "arkmicro"

config SYS_CONFIG_NAME
	default "arkn141_dongle_xinshiyu"

endif
```

## u-boot/board/arkmicro/arkn141_zhonghong/Kconfig
```kconfig
if TARGET_ARKN141_ZHONGHONG

config SYS_BOARD
	default "arkn141_zhonghong"

config SYS_VENDOR
	default "arkmicro"

config SYS_CONFIG_NAME
	default "arkn141_zhonghong"

endif
```

## u-boot/board/arkmicro/arkn141s_fpga/Kconfig
```kconfig
if TARGET_ARKN141S_FPGA

config SYS_BOARD
	default "arkn141s_fpga"

config SYS_VENDOR
	default "arkmicro"

config SYS_CONFIG_NAME
	default "arkn141s_fpga"

endif
```

## u-boot/board/arkmicro/tyw-dashboard/Kconfig
```kconfig
if TARGET_TYW_DASHBOARD

config SYS_BOARD
	default "tyw-dashboard"

config SYS_VENDOR
	default "arkmicro"

config SYS_CONFIG_NAME
	default "tyw-dashboard"

endif
```

## u-boot/board/arkmicro/xinshiyu/Kconfig
```kconfig
if TARGET_XINSHIYU

config SYS_BOARD
	default "xinshiyu"

config SYS_VENDOR
	default "arkmicro"

config SYS_CONFIG_NAME
	default "xinshiyu"

endif
```

## u-boot/configs/amt630h_defconfig
```kconfig
CONFIG_ARM=y
CONFIG_SYS_L2CACHE_OFF=y
CONFIG_ARCH_ARKMICRO=y
CONFIG_SYS_TEXT_BASE=0x20030000
CONFIG_TARGET_AMT630H=y
CONFIG_GPIO_BASEADDR=0x60900000
CONFIG_SPI_CS0_GPIO=88
# CONFIG_ARCH_FIXUP_FDT_MEMORY is not set
CONFIG_BOOTDELAY=0
CONFIG_DEFAULT_FDT_FILE="amt630h.dtb"
# CONFIG_DISPLAY_CPUINFO is not set
# CONFIG_DISPLAY_BOARDINFO is not set
CONFIG_HUSH_PARSER=y
CONFIG_CMD_BOOTZ=y
CONFIG_CMD_MMC=y
CONFIG_CMD_USB=y
CONFIG_CMD_USB_SDP=y
CONFIG_CMD_USB_MASS_STORAGE=y
CONFIG_CMD_FAT=y
CONFIG_CMD_MTDPARTS=y
CONFIG_MTDIDS_DEFAULT="nor0=m25p80"
CONFIG_MTDPARTS_DEFAULT="mtdparts=m25p80:128k(bootstrap),512k(bootloader),128k(bootloaderenv),128k(fdt),3m(kernel),128k(usrdata),64k(reserve),64k(customid),-(rootfs)"
# CONFIG_NET is not set
CONFIG_MMC_DW=y
CONFIG_CONS_INDEX=0
CONFIG_PL011_SERIAL=y
CONFIG_SPI=y
CONFIG_ARK_SPI=y
CONFIG_USB=y
CONFIG_USB_DWC2=y
CONFIG_USB_STORAGE=y
CONFIG_USB_GADGET=y
CONFIG_USB_GADGET_DWC2_OTG=y
CONFIG_USB_GADGET_DOWNLOAD=y
CONFIG_OF_LIBFDT=y
```

## u-boot/configs/ark1668e_devb_dashboard_defconfig
```kconfig
CONFIG_ARM=y
CONFIG_SYS_L2CACHE_OFF=y
CONFIG_SPL_LDSCRIPT="arch/arm/mach-arkmicro/armv7/u-boot-spl.lds"
CONFIG_ARCH_ARKMICRO=y
CONFIG_SYS_TEXT_BASE=0x40030000
CONFIG_SPL_GPIO_SUPPORT=y
CONFIG_SPL_LIBCOMMON_SUPPORT=y
CONFIG_SPL_LIBGENERIC_SUPPORT=y
CONFIG_SPL_SERIAL_SUPPORT=y
CONFIG_SPL=y
CONFIG_DEBUG_UART_BASE=0xe8200000
CONFIG_DEBUG_UART_CLOCK=24000000
CONFIG_TARGET_ARK1668E_DEVB_DASHBOARD=y
CONFIG_SPI_CS0_GPIO=101
CONFIG_SD_DEV_PART="1"
CONFIG_EMMCPARTS_DEFAULT="mmcblk0:512k(bootstrap),1m(bootloader),512k(bootloaderenv),512k(fdt),6m(kernel),2m(bootanimation),32m(userdata),-(rootfs)"
CONFIG_DEFAULT_DEVICE_TREE="ark1668e_devb_dashboard"
CONFIG_DEBUG_UART=y
# CONFIG_EXPERT is not set
# CONFIG_ARCH_FIXUP_FDT_MEMORY is not set
CONFIG_NAND_BOOT=y
CONFIG_BOOTDELAY=0
CONFIG_LOGLEVEL=8
CONFIG_DEFAULT_FDT_FILE="ark1668e_devb_dashboard_dashboard.dtb"
# CONFIG_DISPLAY_CPUINFO is not set
# CONFIG_DISPLAY_BOARDINFO is not set
# CONFIG_SPL_RAW_IMAGE_SUPPORT is not set
CONFIG_SYS_MMCSD_RAW_MODE_U_BOOT_USE_SECTOR=y
CONFIG_SYS_MMCSD_RAW_MODE_U_BOOT_SECTOR=0x400
CONFIG_SPL_NAND_SUPPORT=y
CONFIG_HUSH_PARSER=y
CONFIG_CMD_BOOTZ=y
# CONFIG_CMD_CRC32 is not set
CONFIG_CMD_GPIO=y
CONFIG_CMD_MMC=y
CONFIG_CMD_PART=y
CONFIG_CMD_USB=y
CONFIG_CMD_FAT=y
CONFIG_MTDIDS_DEFAULT="nand0=ark-nand"
CONFIG_MTDPARTS_DEFAULT="mtdparts=ark-nand:256k(bootstrap),1m(bootloader),1m(bootloader_bak),512k(bootloaderenv),512k(bootloaderenv_bak),512k(fdt),6m(kernel),5m(bootanimation),4m(reversingtrack),32m(userdata),150m(rootfs),-(ota)"
CONFIG_CMD_UBI=y
CONFIG_OF_CONTROL=y
CONFIG_ENV_IS_IN_NAND=y
# CONFIG_NET is not set
CONFIG_DM=y
CONFIG_CLK=y
CONFIG_DM_GPIO=y
CONFIG_DWAPB_GPIO=y
CONFIG_SPL_MMC_TINY=y
CONFIG_MMC_DW=y
CONFIG_NAND=y
CONFIG_NAND_ARKMICRO=y
CONFIG_SYS_NAND_U_BOOT_LOCATIONS=y
CONFIG_SYS_NAND_U_BOOT_OFFS=0x40000
CONFIG_SYS_NAND_U_BOOT_OFFS_REDUND=0x140000
CONFIG_DM_ETH=y
CONFIG_PWM_ARK=y
CONFIG_CONS_INDEX=0
CONFIG_DEBUG_UART_PL011=y
CONFIG_PL011_SERIAL=y
CONFIG_USB=y
CONFIG_USB_MUSB_HOST=y
CONFIG_USB_MUSB_ARK=y
CONFIG_USB_MUSB_PIO_ONLY=y
CONFIG_USB_STORAGE=y
CONFIG_NO_FB_CLEAR=y
CONFIG_DISPLAY=y
CONFIG_VIDEO_ARKMICRO=y
CONFIG_FAT_WRITE=y
CONFIG_USE_TINY_PRINTF=y
CONFIG_SPL_TINY_MEMSET=y
```

## u-boot/configs/ark1668e_devb_emmc_defconfig
```kconfig
CONFIG_ARM=y
CONFIG_SYS_L2CACHE_OFF=y
CONFIG_SPL_LDSCRIPT="arch/arm/mach-arkmicro/armv7/u-boot-spl.lds"
CONFIG_ARCH_ARKMICRO=y
CONFIG_SYS_TEXT_BASE=0x40030000
CONFIG_SPL_GPIO_SUPPORT=y
CONFIG_SPL_LIBCOMMON_SUPPORT=y
CONFIG_SPL_LIBGENERIC_SUPPORT=y
CONFIG_SPL_MMC_SUPPORT=y
CONFIG_SPL_SERIAL_SUPPORT=y
CONFIG_SPL=y
CONFIG_DEBUG_UART_BASE=0xe8200000
CONFIG_DEBUG_UART_CLOCK=24000000
CONFIG_TARGET_ARK1668E_DEVB_EMMC=y
CONFIG_SPI_CS0_GPIO=101
CONFIG_EMMC_DEV_PART="1"
CONFIG_EMMCPARTS_DEFAULT="mmcblk0:512k(bootstrap),1m(bootloader),1m(bootloader_bak),2m(bootloaderenv),5m(bootanimation),4m(reversingtrack),30m(userdata),1m(fdt),12m(kernel),2048m(rootfs),200m(reserved),1m(fdt_b),12m(kernel_b),2048m(rootfs_b),-(ota)"
CONFIG_DEFAULT_DEVICE_TREE="ark1668e_devb_emmc"
CONFIG_DEBUG_UART=y
# CONFIG_SYS_MALLOC_F is not set
# CONFIG_EXPERT is not set
# CONFIG_ARCH_FIXUP_FDT_MEMORY is not set
CONFIG_SD_BOOT=y
CONFIG_BOOTDELAY=0
CONFIG_LOGLEVEL=8
CONFIG_DEFAULT_FDT_FILE="ark1668e_devb_emmc.dtb"
# CONFIG_DISPLAY_CPUINFO is not set
# CONFIG_DISPLAY_BOARDINFO is not set
# CONFIG_SPL_RAW_IMAGE_SUPPORT is not set
CONFIG_SYS_MMCSD_RAW_MODE_U_BOOT_USE_SECTOR=y
CONFIG_SYS_MMCSD_RAW_MODE_U_BOOT_SECTOR=0x400
CONFIG_SYS_MMCSD_RAW_MODE_U_BOOT_SECTOR_BACK=0xB00
CONFIG_HUSH_PARSER=y
CONFIG_CMD_BOOTZ=y
# CONFIG_CMD_CRC32 is not set
CONFIG_CMD_GPIO=y
CONFIG_CMD_MMC=y
CONFIG_CMD_EMMC=y
CONFIG_CMD_PART=y
CONFIG_CMD_USB=y
CONFIG_CMD_FAT=y
CONFIG_MTDIDS_DEFAULT="nand0=ark-nand"
CONFIG_MTDPARTS_DEFAULT="mtdparts=ark-nand:128k(bootstrap),512k(bootloader),128k(bootloaderenv),128k(fdt),6m(kernel),2m(bootanimation),32m(userdata),-(rootfs)"
CONFIG_OF_CONTROL=y
CONFIG_ENV_IS_IN_MMC=y
# CONFIG_NET is not set
CONFIG_DM=y
CONFIG_CLK=y
CONFIG_DM_GPIO=y
CONFIG_DWAPB_GPIO=y
CONFIG_SPL_MMC_TINY=y
CONFIG_MMC_DW=y
CONFIG_PWM_ARK=y
CONFIG_CONS_INDEX=0
CONFIG_DEBUG_UART_PL011=y
CONFIG_PL011_SERIAL=y
CONFIG_USB=y
CONFIG_USB_MUSB_HOST=y
CONFIG_USB_MUSB_ARK=y
CONFIG_USB_MUSB_PIO_ONLY=y
CONFIG_USB_STORAGE=y
CONFIG_NO_FB_CLEAR=y
CONFIG_DISPLAY=y
CONFIG_VIDEO_ARKMICRO=y
CONFIG_FAT_WRITE=y
CONFIG_USE_TINY_PRINTF=y
CONFIG_SPL_TINY_MEMSET=y
```

## u-boot/configs/ark1668e_fpga_defconfig
```kconfig
CONFIG_ARM=y
CONFIG_SYS_L2CACHE_OFF=y
CONFIG_SPL_LDSCRIPT="arch/arm/mach-arkmicro/armv7/u-boot-spl.lds"
CONFIG_ARCH_ARKMICRO=y
CONFIG_SYS_TEXT_BASE=0x40030000
CONFIG_SPL_GPIO_SUPPORT=y
CONFIG_SPL_LIBCOMMON_SUPPORT=y
CONFIG_SPL_LIBGENERIC_SUPPORT=y
CONFIG_SPL_SERIAL_SUPPORT=y
CONFIG_SPL=y
CONFIG_DEBUG_UART_BASE=0xe8200000
CONFIG_DEBUG_UART_CLOCK=12000000
CONFIG_TARGET_ARK1668E_FPGA=y
CONFIG_GPIO_BASEADDR=0xe4600000
CONFIG_SPI_CS0_GPIO=101
CONFIG_SD_DEV_PART="1"
CONFIG_DEFAULT_DEVICE_TREE="ark1668e_fpga"
CONFIG_DEBUG_UART=y
# CONFIG_CC_OPTIMIZE_FOR_SIZE is not set
# CONFIG_SYS_MALLOC_F is not set
# CONFIG_EXPERT is not set
# CONFIG_ARCH_FIXUP_FDT_MEMORY is not set
CONFIG_NAND_BOOT=y
CONFIG_BOOTDELAY=0
CONFIG_LOGLEVEL=8
CONFIG_DEFAULT_FDT_FILE="ark1668e_fpga.dtb"
# CONFIG_DISPLAY_CPUINFO is not set
# CONFIG_DISPLAY_BOARDINFO is not set
CONFIG_SPL_NAND_SUPPORT=y
CONFIG_HUSH_PARSER=y
CONFIG_CMD_BOOTZ=y
CONFIG_CMD_GPIO=y
CONFIG_CMD_MMC=y
CONFIG_CMD_PING=y
CONFIG_CMD_FAT=y
CONFIG_CMD_MTDPARTS=y
CONFIG_MTDIDS_DEFAULT="nand0=ark-nand"
CONFIG_MTDPARTS_DEFAULT="mtdparts=ark-nand:128k(bootstrap),512k(bootloader),128k(bootloaderenv),128k(fdt),4m(kernel),2m(bootanimation),32m(userdata),-(rootfs)"
CONFIG_OF_CONTROL=y
CONFIG_ENV_IS_IN_NAND=y
CONFIG_NET_RANDOM_ETHADDR=y
CONFIG_DM=y
CONFIG_CLK=y
CONFIG_DM_GPIO=y
CONFIG_DWAPB_GPIO=y
CONFIG_MMC_DW=y
CONFIG_NAND=y
CONFIG_NAND_ARKMICRO=y
CONFIG_SYS_NAND_U_BOOT_LOCATIONS=y
CONFIG_SYS_NAND_U_BOOT_OFFS=0x20000
CONFIG_PHY_MARVELL=y
CONFIG_DM_ETH=y
CONFIG_ARK_ETH_QOS=y
CONFIG_CONS_INDEX=0
CONFIG_DEBUG_UART_PL011=y
CONFIG_PL011_SERIAL=y
CONFIG_SPI=y
CONFIG_ARK_SPI=y
```

## u-boot/configs/arkn141-dongle_defconfig
```kconfig
CONFIG_ARM=y
CONFIG_SYS_L2CACHE_OFF=y
CONFIG_ARCH_ARKMICRO=y
CONFIG_SYS_TEXT_BASE=0x80030000
CONFIG_TARGET_ARKN141_DONGLE=y
CONFIG_ARK_MUSB=y
CONFIG_USB_GPIO_PWR=-1
CONFIG_USB_GPIO_ID=0
CONFIG_SMBIOS_PRODUCT_NAME="ark1668"
# CONFIG_ARCH_FIXUP_FDT_MEMORY is not set
CONFIG_NAND_BOOT=y
CONFIG_BOOTDELAY=0
CONFIG_DEFAULT_FDT_FILE="arkn141-dongle.dtb"
# CONFIG_DISPLAY_CPUINFO is not set
# CONFIG_DISPLAY_BOARDINFO is not set
CONFIG_HUSH_PARSER=y
CONFIG_CMD_BOOTZ=y
CONFIG_CMD_GPIO=y
CONFIG_CMD_MMC=y
CONFIG_CMD_USB=y
CONFIG_CMD_FAT=y
CONFIG_CMD_MTDPARTS=y
CONFIG_MTDIDS_DEFAULT="nand0=ark-nand"
CONFIG_MTDPARTS_DEFAULT="mtdparts=ark-nand:128k(bootstrap),640k(bootloader),640k(bootloader_back),128k(bootloaderenv),128k(fdt),4m(kernel),4m(userdata),-(rootfs)"
CONFIG_ENV_IS_IN_NAND=y
# CONFIG_NET is not set
CONFIG_MMC_DW=y
CONFIG_NAND=y
CONFIG_NAND_ARKMICRO=y
CONFIG_CONS_INDEX=0
CONFIG_PL011_SERIAL=y
CONFIG_USB=y
CONFIG_USB_MUSB_HCD=y
CONFIG_USB_ARK=y
CONFIG_USB_STORAGE=y
CONFIG_REGEX=y
CONFIG_OF_LIBFDT=y
```

## u-boot/configs/arkn141_hjyb_defconfig
```kconfig
CONFIG_ARM=y
CONFIG_SYS_L2CACHE_OFF=y
CONFIG_ARCH_ARKMICRO=y
CONFIG_SYS_TEXT_BASE=0x80030000
CONFIG_TARGET_ARKN141_HJYB=y
CONFIG_SMBIOS_PRODUCT_NAME="ark1668"
# CONFIG_ARCH_FIXUP_FDT_MEMORY is not set
CONFIG_BOOTDELAY=0
CONFIG_DEFAULT_FDT_FILE="arkn141-hjyb.dtb"
# CONFIG_DISPLAY_CPUINFO is not set
# CONFIG_DISPLAY_BOARDINFO is not set
CONFIG_HUSH_PARSER=y
CONFIG_CMD_BOOTZ=y
CONFIG_CMD_GPIO=y
CONFIG_CMD_MMC=y
CONFIG_CMD_SF=y
CONFIG_CMD_FAT=y
CONFIG_CMD_MTDPARTS=y
CONFIG_MTDIDS_DEFAULT="nor0=m25p80"
CONFIG_MTDPARTS_DEFAULT="mtdparts=m25p80:128k(bootstrap),512k(bootloader),128k(bootloaderenv),128k(fdt),3m(kernel),128k(usrdata),64k(reserve),64k(customid),-(rootfs)"
CONFIG_ENV_IS_IN_SPI_FLASH=y
# CONFIG_NET is not set
CONFIG_MMC_DW=y
CONFIG_SPI_FLASH=y
CONFIG_SPI_FLASH_MACRONIX=y
CONFIG_SPI_FLASH_WINBOND=y
CONFIG_SPI_FLASH_MTD=y
CONFIG_CONS_INDEX=0
CONFIG_PL011_SERIAL=y
CONFIG_SPI=y
CONFIG_ARK_SPI=y
CONFIG_REGEX=y
CONFIG_OF_LIBFDT=y
```

## u-boot/configs/arkn141_zhonghong_defconfig
```kconfig
CONFIG_ARM=y
CONFIG_SYS_L2CACHE_OFF=y
CONFIG_ARCH_ARKMICRO=y
CONFIG_SYS_TEXT_BASE=0x80030000
CONFIG_TARGET_ARKN141_ZHONGHONG=y
CONFIG_SMBIOS_PRODUCT_NAME="ark1668"
# CONFIG_ARCH_FIXUP_FDT_MEMORY is not set
CONFIG_NAND_BOOT=y
CONFIG_BOOTDELAY=0
CONFIG_DEFAULT_FDT_FILE="arkn141_zhonghong.dtb"
# CONFIG_DISPLAY_CPUINFO is not set
# CONFIG_DISPLAY_BOARDINFO is not set
CONFIG_HUSH_PARSER=y
CONFIG_CMD_BOOTZ=y
CONFIG_CMD_GPIO=y
CONFIG_CMD_MMC=y
CONFIG_CMD_FAT=y
CONFIG_CMD_MTDPARTS=y
CONFIG_MTDIDS_DEFAULT="nand0=ark-nand"
CONFIG_MTDPARTS_DEFAULT="mtdparts=ark-nand:128k(bootstrap),640k(bootloader),640k(bootloader_back),128k(bootloaderenv),128k(fdt),4m(kernel),8m(userdata),-(rootfs)"
CONFIG_ENV_IS_IN_NAND=y
# CONFIG_NET is not set
CONFIG_MMC_DW=y
CONFIG_NAND=y
CONFIG_NAND_ARKMICRO=y
CONFIG_CONS_INDEX=0
CONFIG_PL011_SERIAL=y
CONFIG_REGEX=y
CONFIG_OF_LIBFDT=y
```

## u-boot/configs/arkn141s_fpga_defconfig
```kconfig
CONFIG_ARM=y
CONFIG_SYS_L2CACHE_OFF=y
CONFIG_ARCH_ARKMICRO=y
CONFIG_SYS_TEXT_BASE=0x80030000
CONFIG_DEBUG_UART_BASE=0x4040B000
CONFIG_DEBUG_UART_CLOCK=12000000
CONFIG_TARGET_ARKN141S_FPGA=y
CONFIG_GPIO_BASEADDR=0x40409000
CONFIG_SPI_CS0_GPIO=20
CONFIG_SD_DEV_PART="0"
CONFIG_DEFAULT_DEVICE_TREE="arkn141s_fpga"
CONFIG_DEBUG_UART=y
# CONFIG_ARCH_FIXUP_FDT_MEMORY is not set
CONFIG_SPI_BOOT=y
CONFIG_BOOTDELAY=5
CONFIG_LOGLEVEL=8
CONFIG_DEFAULT_FDT_FILE="arkn141s_fpga.dtb"
# CONFIG_DISPLAY_CPUINFO is not set
# CONFIG_DISPLAY_BOARDINFO is not set
CONFIG_HUSH_PARSER=y
CONFIG_CMD_BOOTZ=y
CONFIG_CMD_GPIO=y
CONFIG_CMD_MMC=y
CONFIG_CMD_SF=y
CONFIG_CMD_FAT=y
CONFIG_CMD_MTDPARTS=y
CONFIG_MTDIDS_DEFAULT="nor0=m25p80"
CONFIG_MTDPARTS_DEFAULT="mtdparts=m25p80:128k(bootstrap),512k(bootloader),128k(bootloaderenv),128k(fdt),3m(kernel),128k(usrdata),64k(reserve),64k(customid),-(rootfs)"
CONFIG_ENV_IS_IN_SPI_FLASH=y
# CONFIG_NET is not set
CONFIG_CLK=y
CONFIG_MMC_DW=y
CONFIG_SPI_FLASH=y
CONFIG_SPI_FLASH_MACRONIX=y
CONFIG_SPI_FLASH_WINBOND=y
CONFIG_SPI_FLASH_MTD=y
CONFIG_CONS_INDEX=1
CONFIG_DEBUG_UART_PL011=y
CONFIG_PL011_SERIAL=y
CONFIG_SPI=y
CONFIG_ARK_SPI=y
CONFIG_SPI_FLASH_BAR=y
CONFIG_REGEX=y
CONFIG_OF_LIBFDT=y
```

## u-boot/configs/tyw-dashboard_defconfig
```kconfig
CONFIG_ARM=y
CONFIG_SYS_L2CACHE_OFF=y
CONFIG_SPL_LDSCRIPT="arch/arm/mach-arkmicro/armv7/u-boot-spl.lds"
CONFIG_ARCH_ARKMICRO=y
CONFIG_SYS_TEXT_BASE=0x30000
CONFIG_SPL_GPIO_SUPPORT=y
CONFIG_SPL_LIBCOMMON_SUPPORT=y
CONFIG_SPL_LIBGENERIC_SUPPORT=y
CONFIG_SPL_MMC_SUPPORT=y
CONFIG_SPL_SERIAL_SUPPORT=y
CONFIG_SPL=y
CONFIG_DEBUG_UART_BASE=0xe4200000
CONFIG_DEBUG_UART_CLOCK=24000000
CONFIG_TARGET_TYW_DASHBOARD=y
CONFIG_EMMC_DEV_PART="1"
CONFIG_EMMCPARTS_DEFAULT="mmcblk1:512k(bootstrap),512k(bootstrap_bak),1m(bootloader),1m(bootloader_bak),512k(bootloaderenv),512k(fdt),6m(kernel),2m(bootanimation),32m(userdata),-(rootfs)"
CONFIG_ARK_MUSB=y
CONFIG_USB_DEV_PART="1"
CONFIG_USB_GPIO_ID=1
CONFIG_DEBUG_UART=y
# CONFIG_EXPERT is not set
# CONFIG_ARCH_FIXUP_FDT_MEMORY is not set
CONFIG_SD_BOOT=y
CONFIG_BOOTDELAY=0
CONFIG_LOGLEVEL=8
CONFIG_DEFAULT_FDT_FILE="tyw-dashboard.dtb"
# CONFIG_DISPLAY_CPUINFO is not set
# CONFIG_DISPLAY_BOARDINFO is not set
# CONFIG_SPL_RAW_IMAGE_SUPPORT is not set
CONFIG_SYS_MMCSD_RAW_MODE_U_BOOT_USE_SECTOR=y
CONFIG_SYS_MMCSD_RAW_MODE_U_BOOT_SECTOR=0x800
CONFIG_SYS_MMCSD_RAW_MODE_U_BOOT_SECTOR_BACK=0x1000
CONFIG_HUSH_PARSER=y
CONFIG_CMD_BOOTZ=y
# CONFIG_CMD_CRC32 is not set
CONFIG_CMD_GPIO=y
CONFIG_CMD_MMC=y
CONFIG_CMD_EMMC=y
CONFIG_CMD_PART=y
CONFIG_CMD_USB=y
CONFIG_CMD_FAT=y
CONFIG_MTDIDS_DEFAULT="nand0=ark-nand"
CONFIG_MTDPARTS_DEFAULT="mtdparts=ark-nand:128k(bootstrap),640k(bootloader),640k(bootloader_back),128k(bootloaderenv),128k(fdt),4m(kernel),2m(bootanimation),4m(userdata),-(rootfs)"
CONFIG_ENV_IS_IN_MMC=y
# CONFIG_NET is not set
CONFIG_SPL_MMC_TINY=y
CONFIG_MMC_DW=y
CONFIG_CONS_INDEX=0
CONFIG_DEBUG_UART_PL011=y
CONFIG_PL011_SERIAL=y
CONFIG_USB=y
CONFIG_USB_MUSB_HCD=y
CONFIG_USB_ARK=y
CONFIG_USB_STORAGE=y
CONFIG_USE_TINY_PRINTF=y
CONFIG_SPL_TINY_MEMSET=y
CONFIG_OF_LIBFDT=y
```

## u-boot/drivers/video/arkmicro/Kconfig
```kconfig
menuconfig VIDEO_ARKMICRO
	bool "Enable ARKMICRO lcd support"
	depends on DISPLAY

choice
	prompt "ARKMICRO lcd support"
	depends on VIDEO_ARKMICRO

config VIDEO_ARKMICRO_ARK1668E
	bool "ARK1668E lcd support"
	default y

config VIDEO_ARKMICRO_ARK1668
	bool "ARK1668 lcd support"

endchoice
```
