## linux/drivers/input/touchscreen/cyttsp/Kconfig
```kconfig
#config TOUCHSCREEN_CYPRESS_CYTTSP
#	tristate "Cypress CYTTSP Touchscreen"
menuconfig TOUCHSCREEN_CYPRESS_CYTTSP
	bool "Cypress CYTTSP Touchscreen"
	depends on INPUT_TOUCHSCREEN
	help
		Say Y here if you have a touchscreen using controller from
		the Cypress TrueTouch(tm) Standard Product family connected
		to your system. You will also need to select appropriate
		driver below.
		
		If unsure, say N.

		To compile this driver as a module, choose M here: the
		module will be called cyttsp_core.

if TOUCHSCREEN_CYPRESS_CYTTSP

config TOUCHSCREEN_CYPRESS_CYTTSP5
	tristate "Parade TrueTouch Gen5 Touchscreen Driver"
	depends on TOUCHSCREEN_CYPRESS_CYTTSP
	help
	  Core driver for Parade TrueTouch(tm) Standard Product
	  Geneartion5 touchscreen controllers.

	  Say Y here if you have a Parade Gen5 touchscreen.

	  If unsure, say N.

	  To compile this driver as a module, choose M here: the
	  module will be called cyttsp5.

config TOUCHSCREEN_CYPRESS_CYTTSP5_DEVICETREE_SUPPORT
	bool "Enable Device Tree support"
	depends on TOUCHSCREEN_CYPRESS_CYTTSP5
	help
	  Say Y here to enable support for device tree.

	  If unsure, say N.

config TOUCHSCREEN_CYPRESS_CYTTSP5_I2C
	default y
	tristate "Parade TrueTouch Gen5 I2C"
	depends on TOUCHSCREEN_CYPRESS_CYTTSP5
	select I2C
	help
	  Say Y here to enable I2C bus interface to Parade TrueTouch(tm)
	  Standard Product Generation5 touchscreen controller.

	  If unsure, say Y.

	  To compile this driver as a module, choose M here: the
	  module will be called cyttsp5_i2c.

config TOUCHSCREEN_CYPRESS_CYTTSP5_SPI
	tristate "Parade TrueTouch Gen5 SPI"
	depends on TOUCHSCREEN_CYPRESS_CYTTSP5
	select SPI
	help
	  Say Y here to enable SPI bus interface to Parade TrueTouch(tm)
	  Standard Product Generation5 touchscreen controller.

	  If unsure, say N.

	  To compile this driver as a module, choose M here: the
	  module will be called cyttsp5_spi.

choice
	bool "Parade TrueTouch Gen5 MultiTouch Protocol"
	depends on TOUCHSCREEN_CYPRESS_CYTTSP5
	default TOUCHSCREEN_CYPRESS_CYTTSP5_MT_B
	help
	  This option controls which MultiTouch protocol will be used to
	  report the touch events.

config TOUCHSCREEN_CYPRESS_CYTTSP5_MT_A
	bool "Protocol A"
	help
	  Select to enable MultiTouch touch reporting using protocol A
	  on Parade TrueTouch(tm) Standard Product Generation4 touchscreen
	  controller.

config TOUCHSCREEN_CYPRESS_CYTTSP5_MT_B
	bool "Protocol B"
	help
	  Select to enable MultiTouch touch reporting using protocol B
	  on Parade TrueTouch(tm) Standard Product Generation4 touchscreen
	  controller.
endchoice

config TOUCHSCREEN_CYPRESS_CYTTSP5_BUTTON
	bool "Parade TrueTouch Gen5 MultiTouch CapSense Button"
	depends on TOUCHSCREEN_CYPRESS_CYTTSP5
	help
	  Say Y here to enable CapSense reporting on Parade TrueTouch(tm)
	  Standard Product Generation5 touchscreen controller.

	  If unsure, say N.

config TOUCHSCREEN_CYPRESS_CYTTSP5_PROXIMITY
	default y
	tristate "Parade TrueTouch Gen5 Proximity"
	depends on TOUCHSCREEN_CYPRESS_CYTTSP5
	help
	  Say Y here to enable proximity reporting on Parade TrueTouch(tm)
	  Standard Product Generation5 touchscreen controller.

	  If unsure, say N.

config TOUCHSCREEN_CYPRESS_CYTTSP5_DEVICE_ACCESS
	tristate "Parade TrueTouch Gen5 MultiTouch Device Access"
	depends on TOUCHSCREEN_CYPRESS_CYTTSP5
	help
	  Say Y here to enable Parade TrueTouch(tm) Standard Product
	  Generation5 touchscreen controller device access module.

	  This modules adds an interface to access touchscreen
	  controller using driver sysfs nodes.

	  If unsure, say N.

	  To compile this driver as a module, choose M here: the
	  module will be called cyttsp5_device_access.

config TOUCHSCREEN_CYPRESS_CYTTSP5_DEVICE_ACCESS_API
	bool "Enable Device Access kernel API"
	depends on TOUCHSCREEN_CYPRESS_CYTTSP5_DEVICE_ACCESS
	help
	  Say Y here to enable Device access kernel API which provides
	  access to Parade TrueTouch(tm) Standard Product Generation5
	  touchscreen controller for other modules.

	  If unsure, say N.

config TOUCHSCREEN_CYPRESS_CYTTSP5_TEST_DEVICE_ACCESS_API
	tristate "Simple Test module for Device Access kernel API"
	depends on TOUCHSCREEN_CYPRESS_CYTTSP5_DEVICE_ACCESS
	depends on TOUCHSCREEN_CYPRESS_CYTTSP5_DEVICE_ACCESS_API
	help
	  Say Y here to enable test module for Device access kernel API.

	  If unsure, say N.

	  To compile this driver as a module, choose M here: the
	  module will be called cyttsp5_test_device_access_api.

config TOUCHSCREEN_CYPRESS_CYTTSP5_LOADER
	tristate "Parade TrueTouch Gen5 MultiTouch Loader"
	depends on TOUCHSCREEN_CYPRESS_CYTTSP5
	help
	  Say Y here to enable Parade TrueTouch(tm) Standard Product
	  Generation5 touchscreen controller FW Loader module.

	  This module enables support for Firmware upgrade.

	  If unsure, say Y.

	  To compile this driver as a module, choose M here: the
	  module will be called cyttsp5_loader.

config TOUCHSCREEN_CYPRESS_CYTTSP5_PLATFORM_FW_UPGRADE
	bool "FW upgrade from header file"
	depends on TOUCHSCREEN_CYPRESS_CYTTSP5_LOADER
	help
	  Say Y here to include Parade TrueTouch(tm) Standard Product
	  Generation5 device Firmware into driver.

	  Need proper header file for this.

	  If unsure, say N.

config TOUCHSCREEN_CYPRESS_CYTTSP5_BINARY_FW_UPGRADE
	bool "FW upgrade from binary file"
	depends on TOUCHSCREEN_CYPRESS_CYTTSP5_LOADER
	help
	  Say Y here to include Parade TrueTouch(tm) Standard Product
	  Generation5 device Firmware into kernel as binary blob.

	  This should be enabled for manual FW upgrade support.

	  If unsure, say Y.

config TOUCHSCREEN_CYPRESS_CYTTSP5_PLATFORM_TTCONFIG_UPGRADE
	bool "TT Configuration upgrade from header file"
	depends on TOUCHSCREEN_CYPRESS_CYTTSP5_LOADER
	help
	  Say Y here to include Parade TrueTouch(tm) Standard Product
	  Generation5 device TrueTouch Configuration into kernel itself.

	  Need proper header file for this.

	  If unsure, say N.

config TOUCHSCREEN_CYPRESS_CYTTSP5_MANUAL_TTCONFIG_UPGRADE
	bool "TT Configuration upgrade via SysFs"
	depends on TOUCHSCREEN_CYPRESS_CYTTSP5_LOADER
	help
	  Say Y here to provide a SysFs interface to upgrade TrueTouch
	  Configuration with a binary configuration file.

	  Need proper binary version of config file for this
	  feature.

	  If unsure, say Y.

config TOUCHSCREEN_CYPRESS_CYTTSP5_DEBUG_MDL
	tristate "Parade TrueTouch Gen5 MultiTouch Debug Module"
	depends on TOUCHSCREEN_CYPRESS_CYTTSP5
	help
	  Say Y here to enable Parade TrueTouch(tm) Standard Product
	  Generation5 Debug module.

	  This module adds support for verbose printing touch
	  information.

	  If unsure, say N.

	  To compile this driver as a module, choose M here: the
	  module will be called cyttsp5_debug.

config TOUCHSCREEN_CYPRESS_CYTTSP6
        tristate "Cypress TrueTouch Gen6 Touchscreen Driver"
        help
          Core driver for Cypress TrueTouch(tm) Standard Product
          Generation4 touchscreen controllers.

          Say Y here if you have a Cypress Gen6 touchscreen.

          If unsure, say N.

          To compile this driver as a module, choose M here: the
          module will be called cyttsp6.

config TOUCHSCREEN_CYPRESS_CYTTSP6_DEVICETREE_SUPPORT
        bool "Enable Device Tree support"
        depends on TOUCHSCREEN_CYPRESS_CYTTSP6 && OF
        help
          Say Y here to enable support for device tree.

          If unsure, say N.

config TOUCHSCREEN_CYPRESS_CYTTSP6_DEBUG
        bool "Enable debug output"
        depends on TOUCHSCREEN_CYPRESS_CYTTSP6
        help
          Say Y here to enable debug output for Cypress TrueTouch(tm)
          Standard Product Generation4 drivers set.

          If unsure, say N.

config TOUCHSCREEN_CYPRESS_CYTTSP6_VDEBUG
        bool "Enable verbose debug output"
        depends on TOUCHSCREEN_CYPRESS_CYTTSP6_DEBUG
        help
          Say Y here to enable verbose debug output for Cypress TrueTouch(tm)
          Standard Product Generation4 drivers set.

          If unsure, say N.

config TOUCHSCREEN_CYPRESS_CYTTSP6_I2C
        tristate "Cypress TrueTouch Gen6 I2C"
        depends on TOUCHSCREEN_CYPRESS_CYTTSP6
        select I2C
        help
          Say Y here to enable I2C bus interface to Cypress TrueTouch(tm)
          Standard Product Generation4 touchscreen controller.

          If unsure, say Y.

          To compile this driver as a module, choose M here: the
          module will be called cyttsp6_i2c.

config TOUCHSCREEN_CYPRESS_CYTTSP6_SPI
        tristate "Cypress TrueTouch Gen6 SPI"
        depends on TOUCHSCREEN_CYPRESS_CYTTSP6
        select SPI
        help
          Say Y here to enable SPI bus interface to Cypress TrueTouch(tm)
          Standard Product Generation4 touchscreen controller.

          If unsure, say N.

          To compile this driver as a module, choose M here: the
          module will be called cyttsp6_spi.

choice
        bool "Cypress TrueTouch Gen6 MultiTouch Protocol"
        depends on TOUCHSCREEN_CYPRESS_CYTTSP6
        default TOUCHSCREEN_CYPRESS_CYTTSP6_MT_B
        help
          This option controls which MultiTouch protocol will be used to
          report the touch events.

config TOUCHSCREEN_CYPRESS_CYTTSP6_MT_A
        bool "Protocol A"
        help
          Select to enable MultiTouch touch reporting using protocol A
          on Cypress TrueTouch(tm) Standard Product Generation4 touchscreen
          controller.

config TOUCHSCREEN_CYPRESS_CYTTSP6_MT_B
        bool "Protocol B"
        help
          Select to enable MultiTouch touch reporting using protocol B
          on Cypress TrueTouch(tm) Standard Product Generation4 touchscreen
          controller.

endchoice

config TOUCHSCREEN_CYPRESS_CYTTSP6_BUTTON
        bool "Cypress TrueTouch Gen6 MultiTouch CapSense Button"
        depends on TOUCHSCREEN_CYPRESS_CYTTSP6
        help
          Say Y here to enable CapSense reporting on Cypress TrueTouch(tm)
          Standard Product Generation4 touchscreen controller.

          If unsure, say N.

config TOUCHSCREEN_CYPRESS_CYTTSP6_PROXIMITY
        bool "Cypress TrueTouch Gen6 Proximity"
        depends on TOUCHSCREEN_CYPRESS_CYTTSP6
        help
          Say Y here to enable proximity reporting on Cypress TrueTouch(tm)
          Standard Product Generation4 touchscreen controller.

          If unsure, say N.

config TOUCHSCREEN_CYPRESS_CYTTSP6_DEVICE_ACCESS
        tristate "Cypress TrueTouch Gen6 MultiTouch Device Access"
        depends on TOUCHSCREEN_CYPRESS_CYTTSP6
        help
          Say Y here to enable Cypress TrueTouch(tm) Standard Product
          Generation4 touchscreen controller device access module.

          This modules adds an interface to access touchscreen
          controller using driver sysfs nodes.

          If unsure, say N.

          To compile this driver as a module, choose M here: the
          module will be called cyttsp6_device_access.

config TOUCHSCREEN_CYPRESS_CYTTSP6_DEVICE_ACCESS_API
        bool "Enable Device Access kernel API"
        depends on TOUCHSCREEN_CYPRESS_CYTTSP6_DEVICE_ACCESS
        help
          Say Y here to enable Device access kernel API which provides
          access to Cypress TrueTouch(tm) Standard Product Generation4
          touchscreen controller for other modules.

          If unsure, say N.

config TOUCHSCREEN_CYPRESS_CYTTSP6_TEST_DEVICE_ACCESS_API
        tristate "Simple Test module for Device Access kernel API"
        depends on TOUCHSCREEN_CYPRESS_CYTTSP6_DEVICE_ACCESS
        depends on TOUCHSCREEN_CYPRESS_CYTTSP6_DEVICE_ACCESS_API
        help
          Say Y here to enable test module for Device access kernel API.

          If unsure, say N.

          To compile this driver as a module, choose M here: the
          module will be called cyttsp6_test_device_access_api.

config TOUCHSCREEN_CYPRESS_CYTTSP6_LOADER
        tristate "Cypress TrueTouch Gen6 MultiTouch Loader"
        depends on TOUCHSCREEN_CYPRESS_CYTTSP6
        help
          Say Y here to enable Cypress TrueTouch(tm) Standard Product
          Generation4 touchscreen controller FW Loader module.

          This module enables support for firmware upgrade.

          If unsure, say N.

          To compile this driver as a module, choose M here: the
          module will be called cyttsp6_loader.

config TOUCHSCREEN_CYPRESS_CYTTSP6_PLATFORM_FW_UPGRADE
        bool "FW upgrade from header file"
        depends on TOUCHSCREEN_CYPRESS_CYTTSP6_LOADER
        help
          Say Y here to include Cypress TrueTouch(tm) Standard Product
          Generation4 device firmware into driver.

          Need proper header file for this.

          If unsure, say N.

config TOUCHSCREEN_CYPRESS_CYTTSP6_BINARY_FW_UPGRADE
        bool "FW upgrade from binary file"
        depends on TOUCHSCREEN_CYPRESS_CYTTSP6_LOADER
        help
          Say Y here to include Cypress TrueTouch(tm) Standard Product
          Generation4 device firmware into kernel as binary blob.

          This should be enabled for manual FW upgrade support.

          If unsure, say Y.

config TOUCHSCREEN_CYPRESS_CYTTSP6_PLATFORM_TTCONFIG_UPGRADE
        bool "TT Configuration upgrade from header file"
        depends on TOUCHSCREEN_CYPRESS_CYTTSP6_LOADER
        help
          Say Y here to include Cypress TrueTouch(tm) Standard Product
          Generation4 device TrueTouch Configuration into kernel itself.

          Need proper header file for this.

          If unsure, say N.

config TOUCHSCREEN_CYPRESS_CYTTSP6_PLATFORM_TTCONFIG_UPGRADE
        bool "TT Configuration upgrade from header file"
        depends on TOUCHSCREEN_CYPRESS_CYTTSP6_LOADER
        help
          Say Y here to include Cypress TrueTouch(tm) Standard Product
          Generation4 device TrueTouch Configuration into kernel itself.

          Need proper header file for this.

          If unsure, say N.

config TOUCHSCREEN_CYPRESS_CYTTSP6_MANUAL_TTCONFIG_UPGRADE
        bool "TT Configuration upgrade via SysFs"
        depends on TOUCHSCREEN_CYPRESS_CYTTSP6_LOADER
        help
          Say Y here to provide a SysFs interface to upgrade TrueTouch
          Configuration with a binary configuration file.

          Need proper binary version of config file for this
          feature.

          If unsure, say Y.

config TOUCHSCREEN_CYPRESS_CYTTSP6_DEBUG_MDL
        tristate "Cypress TrueTouch Gen6 MultiTouch Debug Module"
        depends on TOUCHSCREEN_CYPRESS_CYTTSP6
        help
          Say Y here to enable Cypress TrueTouch(tm) Standard Product
          Generation4 Debug module.

          This module adds support for verbose printing touch
          information.

          If unsure, say N.

          To compile this driver as a module, choose M here: the
          module will be called cyttsp6_debug.

endif
```

## linux/drivers/media/i2c/pr2000/Kconfig
```kconfig
config VIDEO_PR2000
	tristate "Arkmicro PR2000X video decoder"
	depends on VIDEO_V4L2 && I2C
	---help---
	  Support for the Arkmicro PR2000X video decoders.
```
