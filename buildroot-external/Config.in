## buildroot-external/configs/ark169_defconfig
```kconfig
BR2_arm=y
BR2_cortex_a5=y
BR2_ARM_ENABLE_NEON=y
BR2_ARM_ENABLE_VFP=y
BR2_ARM_FPU_NEON=y
BR2_TOOLCHAIN_EXTERNAL=y
BR2_TOOLCHAIN_EXTERNAL_LINARO_ARM=y
# BR2_TARGET_ENABLE_ROOT_LOGIN is not set
# BR2_TARGET_GENERIC_GETTY is not set
# BR2_TARGET_GENERIC_REMOUNT_ROOTFS_RW is not set
BR2_ROOTFS_OVERLAY="$(BR2_EXTERNAL_ARK_PATH)/board/arkmicro/ark169/rootfs_overlay"
BR2_ROOTFS_POST_BUILD_SCRIPT="$(BR2_EXTERNAL_ARK_PATH)/board/arkmicro/ark169/post_build.sh"
BR2_PACKAGE_BUSYBOX_CONFIG="$(BR2_EXTERNAL_ARK_PATH)/board/arkmicro/ark169/busybox.config"
BR2_PACKAGE_ALSA_UTILS=y
# BR2_PACKAGE_ALSA_UTILS_ALSACTL is not set
# BR2_PACKAGE_ALSA_UTILS_ALSAMIXER is not set
BR2_PACKAGE_ALSA_UTILS_APLAY=y
BR2_PACKAGE_DIRECTFB=y
# BR2_PACKAGE_DIRECTFB_LINUXINPUT is not set
# BR2_PACKAGE_DIRECTFB_KEYBOARD is not set
# BR2_PACKAGE_DIRECTFB_PS2MOUSE is not set
# BR2_PACKAGE_DIRECTFB_SERIALMOUSE is not set
# BR2_PACKAGE_DIRECTFB_TSLIB is not set
# BR2_PACKAGE_DIRECTFB_SVG is not set
BR2_PACKAGE_DIRECTFB_EXAMPLES=y
BR2_PACKAGE_QT5=y
BR2_PACKAGE_QT5BASE_GUI=y
BR2_PACKAGE_QT5BASE_WIDGETS=y
BR2_PACKAGE_QT5BASE_FONTCONFIG=y
BR2_PACKAGE_QT5BASE_JPEG=y
BR2_PACKAGE_QT5BASE_PNG=y
BR2_PACKAGE_QT5BASE_DBUS=y
BR2_PACKAGE_FDK_AAC=y
BR2_PACKAGE_CA_CERTIFICATES=y
BR2_PACKAGE_OPENSSL=y
BR2_PACKAGE_LIBOPENSSL_ENGINES=y
BR2_PACKAGE_LIBUSB=y
BR2_PACKAGE_LIBUSB_EXAMPLES=y
BR2_PACKAGE_LIBUSB_COMPAT=y
BR2_PACKAGE_TSLIB=y
BR2_PACKAGE_MXML=y
BR2_PACKAGE_PROTOBUF=y
# BR2_PACKAGE_IFUPDOWN_SCRIPTS is not set
BR2_TARGET_ROOTFS_UBI=y
BR2_TARGET_ROOTFS_UBI_SUBSIZE=2048
BR2_TARGET_ROOTFS_UBIFS_LEBSIZE=0x1f000
BR2_TARGET_ROOTFS_UBIFS_MAXLEBCNT=960
BR2_PACKAGE_HX170DEC=y
BR2_PACKAGE_LIBGAL=y
BR2_PACKAGE_LIBARKAPI=y
BR2_PACKAGE_LIBDNS_SD=y
CARLINKLIB=y
```

## buildroot-external/configs/arkn141-dongle_defconfig
```kconfig
BR2_arm=y
BR2_cortex_a5=y
BR2_ARM_ENABLE_NEON=y
BR2_ARM_ENABLE_VFP=y
BR2_ARM_FPU_NEON=y
BR2_TOOLCHAIN_EXTERNAL=y
BR2_TOOLCHAIN_EXTERNAL_LINARO_ARM=y
# BR2_TARGET_ENABLE_ROOT_LOGIN is not set
# BR2_TARGET_GENERIC_GETTY is not set
# BR2_TARGET_GENERIC_REMOUNT_ROOTFS_RW is not set
BR2_ROOTFS_OVERLAY="$(BR2_EXTERNAL_ARK_PATH)/board/arkmicro/arkn141-dongle/rootfs_overlay"
BR2_ROOTFS_POST_BUILD_SCRIPT="$(BR2_EXTERNAL_ARK_PATH)/board/arkmicro/arkn141-dongle/post_build.sh"
BR2_PACKAGE_BUSYBOX_CONFIG="$(BR2_EXTERNAL_ARK_PATH)/board/arkmicro/arkn141-dongle/busybox.config"
BR2_PACKAGE_ALSA_UTILS=y
# BR2_PACKAGE_ALSA_UTILS_ALSACTL is not set
# BR2_PACKAGE_ALSA_UTILS_ALSAMIXER is not set
BR2_PACKAGE_ALSA_UTILS_APLAY=y
BR2_PACKAGE_FFMPEG=y
BR2_PACKAGE_FFMPEG_GPL=y
# BR2_PACKAGE_FFMPEG_FFMPEG is not set
BR2_PACKAGE_FFMPEG_ENCODERS=""
BR2_PACKAGE_FFMPEG_DECODERS=""
BR2_PACKAGE_FFMPEG_MUXERS="mov avi"
BR2_PACKAGE_FFMPEG_DEMUXERS="mov avi"
BR2_PACKAGE_FFMPEG_PARSERS=""
BR2_PACKAGE_FFMPEG_BSFS=""
BR2_PACKAGE_FFMPEG_PROTOCOLS="file"
BR2_PACKAGE_FFMPEG_FILTERS=""
# BR2_PACKAGE_FFMPEG_INDEVS is not set
# BR2_PACKAGE_FFMPEG_OUTDEVS is not set
BR2_PACKAGE_DOSFSTOOLS=y
BR2_PACKAGE_DOSFSTOOLS_MKFS_FAT=y
BR2_PACKAGE_OPENSSL=y
BR2_PACKAGE_LIBPNG=y
BR2_PACKAGE_MXML=y
BR2_PACKAGE_LIVE555=y
BR2_PACKAGE_HOSTAPD=y
# BR2_PACKAGE_IFUPDOWN_SCRIPTS is not set
BR2_TARGET_ROOTFS_UBI=y
#spi flash config
#BR2_TARGET_ROOTFS_UBI_PEBSIZE=0x10000
#BR2_TARGET_ROOTFS_UBI_SUBSIZE=1
#BR2_TARGET_ROOTFS_UBIFS_LEBSIZE=0xFF80
#BR2_TARGET_ROOTFS_UBIFS_MINIOSIZE=0x1
#BR2_TARGET_ROOTFS_UBIFS_MAXLEBCNT=192
#nand falsh config
BR2_TARGET_ROOTFS_UBI_SUBSIZE=2048
BR2_TARGET_ROOTFS_UBIFS_LEBSIZE=0x1f000
BR2_TARGET_ROOTFS_UBIFS_MAXLEBCNT=960
BR2_PACKAGE_HX280ENC=y
```

## buildroot-external/configs/arkn141_dongle_xinshiyu_defconfig
```kconfig
BR2_arm=y
BR2_cortex_a5=y
BR2_ARM_ENABLE_NEON=y
BR2_ARM_ENABLE_VFP=y
BR2_ARM_FPU_NEON=y
BR2_TOOLCHAIN_EXTERNAL=y
BR2_TOOLCHAIN_EXTERNAL_LINARO_ARM=y
# BR2_ROOTFS_DEVICE_CREATION_DYNAMIC_EUDEV=y
# BR2_TARGET_ENABLE_ROOT_LOGIN is not set
# BR2_TARGET_GENERIC_GETTY is not set
# BR2_TARGET_GENERIC_REMOUNT_ROOTFS_RW is not set
BR2_ROOTFS_OVERLAY="$(BR2_EXTERNAL_ARK_PATH)/board/arkmicro/arkn141_dongle_xinshiyu/rootfs_overlay"
BR2_ROOTFS_POST_BUILD_SCRIPT="$(BR2_EXTERNAL_ARK_PATH)/board/arkmicro/arkn141_dongle_xinshiyu/post_build.sh"
BR2_PACKAGE_BUSYBOX_CONFIG="$(BR2_EXTERNAL_ARK_PATH)/board/arkmicro/arkn141_dongle_xinshiyu/busybox.config"
BR2_PACKAGE_ALSA_UTILS=y
# BR2_PACKAGE_ALSA_UTILS_ALSACTL is not set
# BR2_PACKAGE_ALSA_UTILS_ALSAMIXER is not set
BR2_PACKAGE_ALSA_UTILS_APLAY=y
BR2_PACKAGE_FAAD2=y
BR2_PACKAGE_FFMPEG=y
BR2_PACKAGE_FFMPEG_GPL=y
# BR2_PACKAGE_FFMPEG_FFMPEG is not set
BR2_PACKAGE_FFMPEG_ENCODERS=""
BR2_PACKAGE_FFMPEG_DECODERS=""
BR2_PACKAGE_FFMPEG_MUXERS="mov avi"
BR2_PACKAGE_FFMPEG_DEMUXERS="mov avi"
BR2_PACKAGE_FFMPEG_PARSERS=""
BR2_PACKAGE_FFMPEG_BSFS=""
BR2_PACKAGE_FFMPEG_PROTOCOLS="file"
BR2_PACKAGE_FFMPEG_FILTERS=""
# BR2_PACKAGE_FFMPEG_INDEVS is not set
# BR2_PACKAGE_FFMPEG_OUTDEVS is not set
BR2_PACKAGE_DOSFSTOOLS=y
BR2_PACKAGE_DOSFSTOOLS_MKFS_FAT=y
BR2_PACKAGE_MTD=y
BR2_PACKAGE_DBUS=y
BR2_PACKAGE_OPUS=y
BR2_PACKAGE_OPENSSL=y
BR2_PACKAGE_LIBPNG=y
BR2_PACKAGE_LIBUSB=y
BR2_PACKAGE_MTDEV=y
BR2_PACKAGE_LIBXML2=y
BR2_PACKAGE_MXML=y
BR2_PACKAGE_LIVE555=y
BR2_PACKAGE_X264=y
BR2_PACKAGE_PCRE2=y
BR2_PACKAGE_PCRE2_16=y
BR2_PACKAGE_HOSTAPD=y
# BR2_PACKAGE_IFUPDOWN_SCRIPTS is not set
BR2_PACKAGE_IPERF=y
BR2_PACKAGE_TCPDUMP=y
BR2_PACKAGE_WIRELESS_TOOLS=y
BR2_PACKAGE_WIRELESS_TOOLS_LIB=y
BR2_PACKAGE_WPA_SUPPLICANT=y
BR2_PACKAGE_WPA_SUPPLICANT_CLI=y
BR2_PACKAGE_WPA_SUPPLICANT_WPA_CLIENT_SO=y
BR2_PACKAGE_WPA_SUPPLICANT_PASSPHRASE=y
BR2_TARGET_ROOTFS_UBI=y
BR2_TARGET_ROOTFS_UBI_SUBSIZE=2048
BR2_TARGET_ROOTFS_UBIFS_LEBSIZE=0x1f000
BR2_TARGET_ROOTFS_UBIFS_MAXLEBCNT=960
BR2_PACKAGE_HX280ENC=y
BR2_PACKAGE_HX170DEC=y
BR2_PACKAGE_LIBGAL=y
BR2_PACKAGE_LIBARKAPI=y
BR2_PACKAGE_LIBDNS_SD=y
BR2_PACKAGE_LIBBT_GUKAI=y
```

## buildroot-external/configs/arkn141_shoulang_defconfig
```kconfig
BR2_arm=y
BR2_cortex_a5=y
BR2_ARM_ENABLE_NEON=y
BR2_ARM_ENABLE_VFP=y
BR2_ARM_FPU_NEON=y
BR2_TOOLCHAIN_EXTERNAL=y
BR2_TOOLCHAIN_EXTERNAL_LINARO_ARM=y
# BR2_TARGET_ENABLE_ROOT_LOGIN is not set
# BR2_TARGET_GENERIC_GETTY is not set
# BR2_TARGET_GENERIC_REMOUNT_ROOTFS_RW is not set
BR2_ROOTFS_OVERLAY="$(BR2_EXTERNAL_ARK_PATH)/board/arkmicro/arkn141-shoulang/rootfs_overlay"
BR2_ROOTFS_POST_BUILD_SCRIPT="$(BR2_EXTERNAL_ARK_PATH)/board/arkmicro/arkn141-shoulang/post_build.sh"
BR2_PACKAGE_BUSYBOX_CONFIG="$(BR2_EXTERNAL_ARK_PATH)/board/arkmicro/arkn141-shoulang/busybox.config"
BR2_PACKAGE_ALSA_UTILS=y
# BR2_PACKAGE_ALSA_UTILS_ALSACTL is not set
# BR2_PACKAGE_ALSA_UTILS_ALSAMIXER is not set
BR2_PACKAGE_ALSA_UTILS_APLAY=y
BR2_PACKAGE_ZLIB=y
BR2_PACKAGE_MXML=y
BR2_PACKAGE_HOSTAPD=y
# BR2_PACKAGE_IFUPDOWN_SCRIPTS is not set
BR2_TARGET_ROOTFS_UBI=y
BR2_TARGET_ROOTFS_UBI_PEBSIZE=0x10000
BR2_TARGET_ROOTFS_UBI_SUBSIZE=1
BR2_TARGET_ROOTFS_UBIFS_LEBSIZE=0xFF80
BR2_TARGET_ROOTFS_UBIFS_MINIOSIZE=0x1
BR2_TARGET_ROOTFS_UBIFS_MAXLEBCNT=192
```

## buildroot-external/configs/tyw-dashboard_defconfig
```kconfig
BR2_arm=y
BR2_cortex_a5=y
BR2_ARM_ENABLE_NEON=y
BR2_ARM_ENABLE_VFP=y
BR2_ARM_FPU_NEON=y
BR2_TOOLCHAIN_EXTERNAL=y
BR2_TOOLCHAIN_EXTERNAL_LINARO_ARM=y
# BR2_TARGET_ENABLE_ROOT_LOGIN is not set
# BR2_TARGET_GENERIC_GETTY is not set
# BR2_TARGET_GENERIC_REMOUNT_ROOTFS_RW is not set
BR2_ROOTFS_OVERLAY="$(BR2_EXTERNAL_ARK_PATH)/board/arkmicro/tyw-dashboard/rootfs_overlay"
BR2_ROOTFS_POST_BUILD_SCRIPT="$(BR2_EXTERNAL_ARK_PATH)/board/arkmicro/tyw-dashboard/post_build.sh"
BR2_PACKAGE_BUSYBOX_CONFIG="$(BR2_EXTERNAL_ARK_PATH)/board/arkmicro/tyw-dashboard/busybox.config"
BR2_PACKAGE_ALSA_UTILS=y
# BR2_PACKAGE_ALSA_UTILS_ALSACTL is not set
# BR2_PACKAGE_ALSA_UTILS_ALSAMIXER is not set
BR2_PACKAGE_ALSA_UTILS_APLAY=y
BR2_PACKAGE_DIRECTFB=y
# BR2_PACKAGE_DIRECTFB_LINUXINPUT is not set
# BR2_PACKAGE_DIRECTFB_KEYBOARD is not set
# BR2_PACKAGE_DIRECTFB_PS2MOUSE is not set
# BR2_PACKAGE_DIRECTFB_SERIALMOUSE is not set
# BR2_PACKAGE_DIRECTFB_TSLIB is not set
# BR2_PACKAGE_DIRECTFB_SVG is not set
BR2_PACKAGE_DIRECTFB_EXAMPLES=y
BR2_PACKAGE_TSLIB=y
BR2_PACKAGE_MXML=y
# BR2_PACKAGE_IFUPDOWN_SCRIPTS is not set
BR2_TARGET_ROOTFS_EXT2=y
BR2_TARGET_ROOTFS_EXT2_2r0=y
BR2_TARGET_ROOTFS_EXT2_SIZE="40M"
# BR2_TARGET_ROOTFS_TAR is not set
BR2_PACKAGE_HX170DEC=y
BR2_PACKAGE_LIBGAL=y
BR2_PACKAGE_LIBARKAPI=y
```

## buildroot-external/configs/xinshiyu_defconfig
```kconfig
BR2_arm=y
BR2_cortex_a5=y
BR2_ARM_ENABLE_NEON=y
BR2_ARM_ENABLE_VFP=y
BR2_ARM_FPU_NEON=y
BR2_TOOLCHAIN_EXTERNAL=y
BR2_TOOLCHAIN_EXTERNAL_LINARO_ARM=y
# BR2_TARGET_ENABLE_ROOT_LOGIN is not set
# BR2_TARGET_GENERIC_GETTY is not set
# BR2_TARGET_GENERIC_REMOUNT_ROOTFS_RW is not set
BR2_ROOTFS_OVERLAY="$(BR2_EXTERNAL_ARK_PATH)/board/arkmicro/xinshiyu/rootfs_overlay"
BR2_ROOTFS_POST_BUILD_SCRIPT="$(BR2_EXTERNAL_ARK_PATH)/board/arkmicro/xinshiyu/post_build.sh"
BR2_PACKAGE_BUSYBOX_CONFIG="$(BR2_EXTERNAL_ARK_PATH)/board/arkmicro/xinshiyu/busybox.config"
BR2_PACKAGE_ALSA_UTILS=y
# BR2_PACKAGE_ALSA_UTILS_ALSACTL is not set
# BR2_PACKAGE_ALSA_UTILS_ALSAMIXER is not set
BR2_PACKAGE_ALSA_UTILS_APLAY=y
BR2_PACKAGE_DIRECTFB=y
# BR2_PACKAGE_DIRECTFB_LINUXINPUT is not set
# BR2_PACKAGE_DIRECTFB_KEYBOARD is not set
# BR2_PACKAGE_DIRECTFB_PS2MOUSE is not set
# BR2_PACKAGE_DIRECTFB_SERIALMOUSE is not set
# BR2_PACKAGE_DIRECTFB_TSLIB is not set
# BR2_PACKAGE_DIRECTFB_SVG is not set
BR2_PACKAGE_DIRECTFB_EXAMPLES=y
BR2_PACKAGE_TSLIB=y
BR2_PACKAGE_MXML=y
BR2_PACKAGE_HOSTAPD=y
# BR2_PACKAGE_IFUPDOWN_SCRIPTS is not set
BR2_PACKAGE_WIRELESS_TOOLS=y
BR2_PACKAGE_WPA_SUPPLICANT=y
BR2_PACKAGE_WPA_SUPPLICANT_CLI=y
BR2_PACKAGE_WPA_SUPPLICANT_WPA_CLIENT_SO=y
BR2_PACKAGE_WPA_SUPPLICANT_PASSPHRASE=y
BR2_TARGET_ROOTFS_UBI=y
BR2_TARGET_ROOTFS_UBI_SUBSIZE=2048
BR2_TARGET_ROOTFS_UBIFS_LEBSIZE=0x1f000
BR2_TARGET_ROOTFS_UBIFS_MAXLEBCNT=960
BR2_PACKAGE_HX170DEC=y
BR2_PACKAGE_LIBGAL=y
BR2_PACKAGE_LIBARKAPI=y
```

## buildroot-external/configs/zhonghong_defconfig
```kconfig
BR2_arm=y
BR2_cortex_a5=y
BR2_ARM_ENABLE_NEON=y
BR2_ARM_ENABLE_VFP=y
BR2_ARM_FPU_NEON=y
BR2_TOOLCHAIN_EXTERNAL=y
BR2_TOOLCHAIN_EXTERNAL_LINARO_ARM=y
# BR2_TARGET_ENABLE_ROOT_LOGIN is not set
# BR2_TARGET_GENERIC_GETTY is not set
# BR2_TARGET_GENERIC_REMOUNT_ROOTFS_RW is not set
BR2_ROOTFS_OVERLAY="$(BR2_EXTERNAL_ARK_PATH)/board/arkmicro/zhonghong/rootfs_overlay"
BR2_ROOTFS_POST_BUILD_SCRIPT="$(BR2_EXTERNAL_ARK_PATH)/board/arkmicro/zhonghong/post_build.sh"
BR2_PACKAGE_BUSYBOX_CONFIG="$(BR2_EXTERNAL_ARK_PATH)/board/arkmicro/zhonghong/busybox.config"
BR2_PACKAGE_ALSA_UTILS=y
# BR2_PACKAGE_ALSA_UTILS_ALSACTL is not set
# BR2_PACKAGE_ALSA_UTILS_ALSAMIXER is not set
BR2_PACKAGE_ALSA_UTILS_APLAY=y
BR2_PACKAGE_MTD=y
BR2_PACKAGE_MTD_MKFSUBIFS=y
BR2_PACKAGE_DIRECTFB=y
# BR2_PACKAGE_DIRECTFB_LINUXINPUT is not set
# BR2_PACKAGE_DIRECTFB_KEYBOARD is not set
# BR2_PACKAGE_DIRECTFB_PS2MOUSE is not set
# BR2_PACKAGE_DIRECTFB_SERIALMOUSE is not set
# BR2_PACKAGE_DIRECTFB_TSLIB is not set
# BR2_PACKAGE_DIRECTFB_SVG is not set
BR2_PACKAGE_DIRECTFB_EXAMPLES=y
BR2_PACKAGE_TSLIB=y
BR2_PACKAGE_MXML=y
# BR2_PACKAGE_IFUPDOWN_SCRIPTS is not set
BR2_TARGET_ROOTFS_UBI=y
BR2_TARGET_ROOTFS_UBI_SUBSIZE=2048
BR2_TARGET_ROOTFS_UBIFS_LEBSIZE=0x1f000
BR2_TARGET_ROOTFS_UBIFS_MAXLEBCNT=960
BR2_PACKAGE_HX170DEC=y
BR2_PACKAGE_LIBGAL=y
BR2_PACKAGE_LIBARKAPI=y
```

## buildroot-external/package/DashBoard/Config.in
```kconfig
config BR2_PACKAGE_DASHBOARD
	bool "DashBoard"
	select BR2_PACKAGE_QT5BASE
	select BR2_PACKAGE_HX170DEC
	select BR2_PACKAGE_LIBARKAPI
	select BR2_PACKAGE_CARLINK
	help
		ark1668e Qt demo
```

## buildroot-external/package/ark1668eapp/Config.in
```kconfig
config BR2_PACKAGE_ARK1668EAPP
	bool "ark1668eapp"
	select BR2_PACKAGE_QT5BASE
	select BR2_PACKAGE_HX170DEC
	select BR2_PACKAGE_LIBARKAPI
	select BR2_PACKAGE_CARLINK
	help
		ark1668e Qt demo
```

## buildroot-external/package/ark1668eft/Config.in
```kconfig
config BR2_PACKAGE_ARK1668EFT
	bool "ark1668eft"
	select BR2_PACKAGE_HX170DEC
	help
		ark1668 final test app
```

## buildroot-external/package/ark1668ft/Config.in
```kconfig
config BR2_PACKAGE_ARK1668FT
	bool "ark1668ft"
	select BR2_PACKAGE_HX170DEC
	select BR2_PACKAGE_LIBGAL
	help
		ark1668 final test app
```

## buildroot-external/package/bluetoothd-test/Config.in
```kconfig
config BR2_PACKAGE_BLUETOOTHD_TEST
	bool "bluetoothd-test"
	help
	  Hardware-confirmed static BlueZ 5.66 bluetoothd (Run 5,
	  2026-08-19) plus its dbus-policy config files, from
	  prado-firmware-reconstruction's tools/bluetoothd-test/. Static
	  and glibc-version-agnostic on purpose (see that tool's own
	  README's "Why static" section) -- NOT rebuilt from source here,
	  same prebuilt-binary reuse as this project's other
	  Buildroot-external packages (libgal, libmali, etc).

	  Not BR2_PACKAGE_BLUEZ5 -- see merry-snacking-wirth.md's Phase 1
	  re-scope note for why BlueZ itself isn't a from-source Buildroot
	  package in this rootfs.
```

## buildroot-external/package/dmesg-tool/Config.in
```kconfig
config BR2_PACKAGE_DMESG_TOOL
	bool "dmesg-tool"
	help
	  Real util-linux 2.40.2 dmesg (static), from
	  prado-firmware-reconstruction's tools/dmesg/ -- richer than
	  BusyBox's built-in applet (-T human timestamps, -x facility/
	  level decode, --color). Named dmesg-tool (not "dmesg") to avoid
	  any Kconfig-symbol collision with BusyBox's own dmesg applet
	  option.
```
