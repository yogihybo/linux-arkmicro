## linux/drivers/media/platform/arkmicro/Kconfig
```kconfig
config VIDEO_ARK1668E_VIN
	tristate "ArkMicro ark1668e videoin driversupport"
	depends on VIDEO_V4L2 && VIDEO_V4L2_SUBDEV_API
	select VIDEOBUF2_DMA_CONTIG
	select REGMAP_MMIO
	select V4L2_FWNODE
	help
	   This is the camera driver for arkmicro

config VIDEO_USE_LOCK
       tristate "set use lock for video"
       depends on ARK1668E_CARBACK
```

## linux/drivers/net/wireless/realtek/rtl8811cu/Kconfig
```kconfig
config RTL8821CU
	tristate "Realtek 8811CU USB WiFi"
	depends on USB
	---help---
	  Help message of RTL8821CU
```

## linux/drivers/net/wireless/realtek/rtl8821cs/Kconfig
```kconfig
config RTL8821CS
	tristate "Realtek 8821C SDIO WiFi"
	help
	This is a driver for RTL8821CS
```

## linux/drivers/soc/arkmicro/Kconfig
```kconfig
menu "Arkmicro SoC drivers"

config ARK_CARBACK
	bool "carback driver"
	default y if SOC_ARK1668

config ARK_MEMALLOC
	bool "app memalloc driver"
	default y if ARCH_ARKMICRO

config ARK_PWMTEST
	bool "pwm test driver"

source "drivers/soc/arkmicro/carback/Kconfig"
source "drivers/soc/arkmicro/power/Kconfig"
source "drivers/soc/arkmicro/camera/Kconfig"
source "drivers/soc/arkmicro/hx170dec/Kconfig"
source "drivers/soc/arkmicro/hx280enc/Kconfig"
source "drivers/soc/arkmicro/isp_scale/Kconfig"
source "drivers/soc/arkmicro/scale/Kconfig"
source "drivers/soc/arkmicro/gsensor/Kconfig"
source "drivers/soc/arkmicro/jpeg/Kconfig"
source "drivers/soc/arkmicro/itu656/Kconfig"
source "drivers/soc/arkmicro/encrypt/Kconfig"

endmenu
```

## linux/drivers/soc/arkmicro/camera/Kconfig
```kconfig
# ArkMicro on-chip Camera control driver configuration
#

config ARK_CAMERA
	tristate "ArkMicro Camera Control Support"
	depends on SOC_ARKN141
	help
	  Say y here to enable ArkMicro camera control driver.

if ARK_CAMERA	
	choice
		prompt "Camera Sensor"
		default SENSOR_IMX322

	config SENSOR_JX_H65
		bool "JX H65"

	config SENSOR_IMX322
		bool "IMX322/323"

	config SENSOR_GC2053
		bool "GC2053"
      
	endchoice  
endif
```

## linux/drivers/soc/arkmicro/encrypt/Kconfig
```kconfig
#
# ENCRYPT IC driver Kconfig
#

menu "ENCRYPT IC support"

config XS508
	tristate "XS508 i2c driver"
	help
		Say Y here if you want to use XS508 on the Arkmicro
		platform.

endmenu
```

## linux/drivers/soc/arkmicro/gsensor/Kconfig
```kconfig
# ArkMicro on-chip g_sensor control driver configuration
#

config ARK_G_SENSOR
	tristate "ArkMicro G_Sensor Control Support"
	#depends on SOC_ARKN141
	help
	  Say y here to enable ArkMicro  G_Sensor.

if ARK_G_SENSOR	
	choice
		prompt "G_Sensor"
		default G_SENSOR_DA380

	config G_SENSOR_DA380
		bool "DA380"
	
      	#config G_SENSOR_SC7A20
	#	bool "SC7A20"

	endchoice  
endif
```

## linux/drivers/soc/arkmicro/hx170dec/Kconfig
```kconfig
#
# Hx170dec controller Kconfig
#

config ARK_HX170DEC
	tristate "ARK hx170dec controller"
	help
		Say Y here if you want to use the hx170dec controller on the Arkmicro
		platform.
```

## linux/drivers/soc/arkmicro/hx280enc/Kconfig
```kconfig
#
# Hx280enc controller Kconfig
#

config ARK_HX280ENC
	tristate "ARK hx280enc controller"
	help
		Say Y here if you want to use the hx280enc controller on the Arkmicro
		platform.
```

## linux/drivers/soc/arkmicro/itu656/Kconfig
```kconfig
#
# ArkMicro on-chip ITU656 input control driver configuration
#
  
menu "ArmMicro Itu656 Input Controller"

config ARKN141_ITU656
	tristate "ArkMicro Arkn141 itu656 input Control Support"
	depends on SOC_ARKN141

	help
	  Say y here to enable ArkMicro Arkn141 itu656 input control driver.

config ARK1668_ITU656
	tristate "ArkMicro Ark1668 itu656 input Control Support"
	depends on SOC_ARK1668
	
	help
	  Say y here to enable ArkMicro Ark1668 itu656 input control driver.

config VIDEO_ARK1668_VIN
	tristate "ArkMicro ark1668 videoin driversupport"
	depends on VIDEO_V4L2 && VIDEO_V4L2_SUBDEV_API
	select VIDEOBUF2_DMA_CONTIG
	select REGMAP_MMIO
	select V4L2_FWNODE
	help
	   This is the camera driver for arkmicro

config ARK7116
	tristate "Support Ark7116 Driver"
	depends on ARKN141_ITU656 || ARK1668_ITU656

	help
	  Say y here to enable ark7116 driver.

config RN6752
	tristate "Support AHD RN6752 Driver"
	depends on ARKN141_ITU656 || ARK1668_ITU656

	help
	  Say y here to enable rn6752 driver.
endmenu
```

## linux/drivers/soc/arkmicro/jpeg/Kconfig
```kconfig
#ArkMicro on-chip jpeg decoder driver configuration
#

config ARK_JPEG_DEC
    tristate "ArkMicro 1668 Jpeg Decoder Support"
    depends on SOC_ARK1668
    help
    Say y here to enable ArkMicro 1668 jpeg decoder driver.config
    ARK_JPEG_BOOT_ANIMATION tristate "ArkMicro 1668 jpeg boot animation" depends
    on ARK_JPEG_DEC help Say y here to enable ArkMicro 1668 jpeg boot animation.
```

## linux/drivers/soc/arkmicro/power/Kconfig
```kconfig
#
# arkn141 power off driver Kconfig
#
menuconfig POWER_OFF_RESET
	bool "Arkn141 board level reset or power off"
	help
	  Provides a number of drivers which either reset a complete board
	  or shut it down, by manipulating the main power supply on the board.

	  Say Y here to enable board reset and power off

if POWER_OFF_RESET

config ARKN141_DONGLE_POWEROFF
	tristate "arkn141 dongle power off driver"
	depends on SOC_ARKN141
	help
	  This driver supports turning off board via a arkn141 dongle 5g wifi power-off driver power off.

endif
```

## linux/drivers/video/fbdev/arkmicro/Kconfig
```kconfig
config FB_ARK1668LCD
	tristate "Ark1668 framebuffer support"
	depends on SOC_ARK1668
	depends on FB && HAS_IOMEM
	select FB_CFB_FILLRECT
	select FB_CFB_COPYAREA
	select FB_CFB_IMAGEBLIT
	select FB_MODE_HELPERS if OF
	select VIDEOMODE_HELPERS if OF
	select BACKLIGHT_LCD_SUPPORT if OF
	select BACKLIGHT_CLASS_DEVICE if OF
	help
	  This framebuffer device driver is for the ARK1668 LCD controller.

config FB_ARKN141LCD
	tristate "Arkn141 framebuffer support"
	depends on SOC_ARKN141
	depends on FB && HAS_IOMEM
	select FB_CFB_FILLRECT
	select FB_CFB_COPYAREA
	select FB_CFB_IMAGEBLIT
	select FB_MODE_HELPERS if OF
	select VIDEOMODE_HELPERS if OF
	select BACKLIGHT_LCD_SUPPORT if OF
	select BACKLIGHT_CLASS_DEVICE if OF
	help
	  This framebuffer device driver is for the ARKN141 LCD controller.

config FB_ARK1668ELCD
	tristate "Ark1668e framebuffer support"
	depends on SOC_ARK1668E
	depends on FB && HAS_IOMEM
	select FB_CFB_FILLRECT
	select FB_CFB_COPYAREA
	select FB_CFB_IMAGEBLIT
	select FB_MODE_HELPERS if OF
	select VIDEOMODE_HELPERS if OF
	select BACKLIGHT_LCD_SUPPORT if OF
	select BACKLIGHT_CLASS_DEVICE if OF
	help
	  This framebuffer device driver is for the ARK1668E LCD controller.

config FB_ARKN141SLCD
	tristate "ARKN141S framebuffer support"
	depends on SOC_ARKN141S
	depends on FB && HAS_IOMEM
	select FB_CFB_FILLRECT
	select FB_CFB_COPYAREA
	select FB_CFB_IMAGEBLIT
	select FB_MODE_HELPERS if OF
	select VIDEOMODE_HELPERS if OF
	select BACKLIGHT_LCD_SUPPORT if OF
	select BACKLIGHT_CLASS_DEVICE if OF
	help
	  This framebuffer device driver is for the ARK1668E LCD controller.
```

## linux/sound/soc/arkmicro/Kconfig
```kconfig
config SND_SOC_ARK
	tristate "ASoC support for Arkmicro"
	depends on ARCH_ARKMICRO || COMPILE_TEST
	help
	  Say Y or M if you want to add support for codecs attached to
	  the Arkmicro SoCs' Audio interfaces. You will also need to
	  select the audio interfaces to support below.

config SND_SOC_ARK1668_I2S
	tristate "ARK1668 I2S Device Driver"
	depends on SND_SOC_ARK && SOC_ARK1668
	select SND_DMAENGINE_PCM
	select SND_SOC_GENERIC_DMAENGINE_PCM
	help
	  Say Y or M if you want to add support for I2S driver for
	  Arkmciro I2S device.

config SND_SOC_ARK1668_ADC
	tristate "ARK1668 ADC for Audio in"
	depends on SND_SOC_ARK && SND_SOC_ARK1668_I2S

config SND_SOC_ARK1668_DAC
	tristate "ARK1668 DAC for Audio out"
	depends on SND_SOC_ARK && SND_SOC_ARK1668_I2S

config SND_SOC_ARK_I2S
	tristate "ARKN141 I2S Device Driver"
	depends on SND_SOC_ARK && SOC_ARKN141
	select SND_DW_DMAENGINE_PCM
	select SND_SOC_GENERIC_DMAENGINE_PCM
	help
	  Say Y or M if you want to add support for I2S driver for
	  Arkmciro I2S device.

config SND_SOC_ARK_INTERNAL_DAC
	tristate "Soc Internal DAC for Audio out"
	depends on SND_SOC_ARK && SND_SOC_ARK_I2S

config SND_SOC_ARK_INTERNAL_ADC
	tristate "Soc Internal ADC for Audio In"
	depends on SND_SOC_ARK && SND_SOC_ARK_I2S

config SND_SOC_ARK_ARKN141
	tristate "SoC Audio support for ARKN141 SoC"
	depends on SND_SOC_ARK && DW_DMAC && SND_SOC_ARK_I2S
	select SND_ARK_SOC_I2S
	select SND_SOC_ARK_INTERNAL_DAC
	select SND_SOC_ARK_INTERNAL_ADC
	help
		Say Y if you want to add ALSA aound driver for 
		ARKN141 SoC

config SND_SOC_ARK1668E_I2S
	tristate "ARK1668E I2S Device Driver"
	depends on SND_SOC_ARK && SOC_ARK1668E
	select SND_DMAENGINE_PCM
	select SND_SOC_GENERIC_DMAENGINE_PCM
	help
	  Say Y or M if you want to add support for I2S driver for
	  Arkmciro I2S device.

config SND_SOC_ARK1668E_INTERNAL_ADAC
	tristate "ARK1668E Internal audio codec for Audio In/out"
	depends on SND_SOC_ARK && SND_SOC_ARK1668E_I2S

config SND_SOC_BD37033
        tristate "Support Audio BD37033 IC Driver"
        depends on SND_SOC_ARK1668E_I2S || SND_SOC_ARK1668_I2S
        help
                Say Y if you want to add ALSA BD37033_Driver

config SND_SOC_BD37033_NOP
        bool "Enable BD37033 NOP mode"
        depends on SND_SOC_BD37033
        help
                Say Y if you don`t want to use audio ic, but you want to use interfaces
                of the BD37033 IC.
                All registers of the bd37033 are not access to read or write.

                Say N if you are not sure.
```

## u-boot/board/arkmicro/amt630h/Kconfig
```kconfig
if TARGET_AMT630H

config SYS_BOARD
	default "amt630h"

config SYS_VENDOR
	default "arkmicro"

config SYS_CONFIG_NAME
	default "amt630h"

endif
```

## u-boot/board/arkmicro/ark1668_limcet_p305/Kconfig
```kconfig
if TARGET_ARK1668_LIMCET_P305

config SYS_BOARD
	default "ark1668_limcet_p305"

config SYS_VENDOR
	default "arkmicro"

config SYS_CONFIG_NAME
	default "ark1668_limcet_p305"

endif
```

## u-boot/board/arkmicro/ark1668e_devb/Kconfig
```kconfig
if TARGET_ARK1668E_DEVB

config SYS_BOARD
	default "ark1668e_devb"

config SYS_VENDOR
	default "arkmicro"

config SYS_CONFIG_NAME
	default "ark1668e_devb"

endif
```

## u-boot/board/arkmicro/ark1668e_devb_dashboard/Kconfig
```kconfig
if TARGET_ARK1668E_DEVB_DASHBOARD

config SYS_BOARD
	default "ark1668e_devb_dashboard"

config SYS_VENDOR
	default "arkmicro"

config SYS_CONFIG_NAME
	default "ark1668e_devb_dashboard"

endif
```

## u-boot/board/arkmicro/ark1668e_devb_emmc/Kconfig
```kconfig
if TARGET_ARK1668E_DEVB_EMMC

config SYS_BOARD
	default "ark1668e_devb_emmc"

config SYS_VENDOR
	default "arkmicro"

config SYS_CONFIG_NAME
	default "ark1668e_devb_emmc"

endif
```

## u-boot/board/arkmicro/ark1668e_fpga/Kconfig
```kconfig
if TARGET_ARK1668E_FPGA

config SYS_BOARD
	default "ark1668e_fpga"

config SYS_VENDOR
	default "arkmicro"

config SYS_CONFIG_NAME
	default "ark1668e_fpga"

endif
```

## u-boot/board/arkmicro/arkn141-dongle/Kconfig
```kconfig
if TARGET_ARKN141_DONGLE

config SYS_BOARD
	default "arkn141-dongle"

config SYS_VENDOR
	default "arkmicro"

config SYS_CONFIG_NAME
	default "arkn141-dongle"

endif
```

## u-boot/board/arkmicro/arkn141-hjyb/Kconfig
```kconfig
if TARGET_ARKN141_HJYB

config SYS_BOARD
	default "arkn141-hjyb"

config SYS_VENDOR
	default "arkmicro"

config SYS_CONFIG_NAME
	default "arkn141-hjyb"

endif
```
